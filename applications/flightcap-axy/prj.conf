## CMakeLists.txt
```
cmake_minimum_required(VERSION 3.20.0)

find_package(Zephyr REQUIRED HINTS $ENV{ZEPHYR_BASE})
project(flightcap_axy LANGUAGES C)

target_include_directories(app PRIVATE
    ${CMAKE_CURRENT_SOURCE_DIR}/src
    ${CMAKE_CURRENT_SOURCE_DIR}/../../lib/lis2dh12
    ${CMAKE_CURRENT_SOURCE_DIR}/../../lib/vbatt
    ${CMAKE_CURRENT_SOURCE_DIR}/../../lib/flightcap_hw
    ${CMAKE_CURRENT_SOURCE_DIR}/../../lib/spi_nor
    ${CMAKE_CURRENT_SOURCE_DIR}/../../lib/vl53l4cd
)

target_sources(app PRIVATE
    src/main.c
    ${CMAKE_CURRENT_SOURCE_DIR}/../../lib/lis2dh12/lis2dh12_zephyr.c
    ${CMAKE_CURRENT_SOURCE_DIR}/../../lib/lis2dh12/lis2dh12_reg.c
    ${CMAKE_CURRENT_SOURCE_DIR}/../../lib/vbatt/vbatt_zephyr.c
    ${CMAKE_CURRENT_SOURCE_DIR}/../../lib/vl53l4cd/vl53l0x_zephyr.c
    ${CMAKE_CURRENT_SOURCE_DIR}/../../lib/flightcap_hw/flightcap_hw.c
)

if(CONFIG_SPI_NOR AND CONFIG_FLASH_JESD216_API)
  target_sources(app PRIVATE
    ${CMAKE_CURRENT_SOURCE_DIR}/../../lib/spi_nor/spi_nor_zephyr.c
  )
endif()
```

## sample.yaml
```
sample:
  name: FlightCap Accelerometer Tester
  description: >
    LIS2DH12 I2C bring-up app for FlightCap with RTT telemetry and motion
    interrupt logging on INT1.

common:
  tags:
    - flightcap
    - accelerometer
    - lis2dh12
    - i2c
    - gpio

tests:
  applications.flightcap-axy:
    platform_allow:
      - FlightCap_nRF52833
    harness: console
```

## prj.conf
```kconfig
# FlightCap accelerometer tester application
CONFIG_GPIO=y
CONFIG_I2C=y
CONFIG_I2C_NRFX=y
CONFIG_ADC=y

# flightcap_hw.c pulls in vl53l0x helpers (tof check unused at runtime).
CONFIG_SENSOR=y
CONFIG_VL53L0X=y

# External MX25R8035 not populated — disable SPI NOR driver.
CONFIG_SPI_NOR=n

# To log external flash present/absent at boot, enable both:
# CONFIG_SPI_NOR=y
# CONFIG_FLASH_JESD216_API=y
# CONFIG_FLASH=y
# CONFIG_FLASH_PAGE_LAYOUT=y

# Logging over RTT
CONFIG_LOG=y
CONFIG_LOG_DEFAULT_LEVEL=3
CONFIG_USE_SEGGER_RTT=y
CONFIG_RTT_CONSOLE=y
CONFIG_CONSOLE=y
CONFIG_SEGGER_RTT_MODE_NO_BLOCK_SKIP=y
CONFIG_UART_CONSOLE=n

# Keep stacks moderate for sensor + logging
CONFIG_MAIN_STACK_SIZE=2048
CONFIG_SYSTEM_WORKQUEUE_STACK_SIZE=2048
```

## src/main.c
```c
#include <zephyr/device.h>
#include <zephyr/drivers/gpio.h>
#include <zephyr/irq.h>
#include <zephyr/kernel.h>
#include <zephyr/logging/log.h>

#include "lis2dh12_zephyr.h"
#include "vbatt_zephyr.h"
#include "flightcap_hw.h"

LOG_MODULE_REGISTER(flightcap_axy, LOG_LEVEL_INF);

#define MAGNET_NODE DT_ALIAS(magnet_sensor)
#define LED0_NODE DT_ALIAS(led0)
#define LED1_NODE DT_ALIAS(led1)
#define ACCEL_INT_NODE DT_ALIAS(accel_int)

#define SAMPLE_PERIOD_MS 1000
#define MOTION_THRESHOLD_MG 16
#define MOTION_DURATION_SAMPLES 0

static const struct gpio_dt_spec magnet = GPIO_DT_SPEC_GET(MAGNET_NODE, gpios);
static const struct gpio_dt_spec led0 = GPIO_DT_SPEC_GET(LED0_NODE, gpios);
static const struct gpio_dt_spec led1 = GPIO_DT_SPEC_GET(LED1_NODE, gpios);
static const struct gpio_dt_spec accel_int = GPIO_DT_SPEC_GET(ACCEL_INT_NODE, gpios);

static struct gpio_callback accel_int_cb;
static volatile uint32_t motion_events;
static struct lis2dh12_dev lis2dh12;

static void leds_set(int value)
{
	(void)gpio_pin_set_dt(&led0, value);
	(void)gpio_pin_set_dt(&led1, value);
}

static void accel_int_callback(const struct device *port, struct gpio_callback *cb, uint32_t pins)
{
	ARG_UNUSED(port);
	ARG_UNUSED(cb);
	ARG_UNUSED(pins);

	motion_events++;
}

int main(void)
{
	int ret;
	uint32_t sample_seq = 0;

	if (!gpio_is_ready_dt(&led0) || !gpio_is_ready_dt(&led1) ||
	    !gpio_is_ready_dt(&magnet) || !gpio_is_ready_dt(&accel_int)) {
		LOG_ERR("GPIO dependency not ready");
		return -ENODEV;
	}

	ret = gpio_pin_configure_dt(&led0, GPIO_OUTPUT_INACTIVE);
	ret |= gpio_pin_configure_dt(&led1, GPIO_OUTPUT_INACTIVE);
	ret |= gpio_pin_configure_dt(&magnet, GPIO_INPUT);
	ret |= gpio_pin_configure_dt(&accel_int, GPIO_INPUT);
	if (ret < 0) {
		LOG_ERR("GPIO configuration failed (%d)", ret);
		return ret;
	}

	{
		struct flightcap_hw_status hw = {0};

		ret = flightcap_hw_check(FLIGHTCAP_HW_VBATT | FLIGHTCAP_HW_ACCEL | FLIGHTCAP_HW_FLASH,
					 &hw);
		if (ret < 0) {
			LOG_WRN("Hardware check reported failures — continuing");
		}
	}

	ret = lis2dh12_zephyr_init(&lis2dh12);
	if (ret < 0) {
		LOG_ERR("LIS2DH12 init failed (%d)", ret);
		return ret;
	}

	ret = lis2dh12_zephyr_config_motion(&lis2dh12, MOTION_THRESHOLD_MG, MOTION_DURATION_SAMPLES);
	if (ret < 0) {
		LOG_ERR("LIS2DH12 motion config failed (%d)", ret);
		return ret;
	}

	gpio_init_callback(&accel_int_cb, accel_int_callback, BIT(accel_int.pin));
	ret = gpio_add_callback(accel_int.port, &accel_int_cb);
	ret |= gpio_pin_interrupt_configure_dt(&accel_int, GPIO_INT_EDGE_TO_ACTIVE);
	if (ret < 0) {
		LOG_ERR("INT1 callback setup failed (%d)", ret);
		return ret;
	}

	LOG_INF("AXY tester started: periodic=%dms, mode=I2C addr=0x19, motion_ths=%u",
		SAMPLE_PERIOD_MS, MOTION_THRESHOLD_MG);

	while (1) {
		uint32_t period_motion;
		unsigned int irq_key = irq_lock();
		int32_t vdd_mv = 0;

		period_motion = motion_events;
		motion_events = 0U;
		irq_unlock(irq_key);

		int16_t x_mg = 0;
		int16_t y_mg = 0;
		int16_t z_mg = 0;
		int8_t temp_c = 0;
		uint8_t int1_src = 0;
		int magnet_state = gpio_pin_get_dt(&magnet);

		if (magnet_state < 0) {
			LOG_ERR("MAG_INT read failed (%d)", magnet_state);
			return magnet_state;
		}

		ret = lis2dh12_zephyr_read_accel_mg(&lis2dh12, &x_mg, &y_mg, &z_mg);
		ret |= lis2dh12_zephyr_read_temp_c(&lis2dh12, &temp_c);
		ret |= lis2dh12_zephyr_read_int1_src(&lis2dh12, &int1_src);
		(void)vbatt_read_mv(&vdd_mv);

		if (ret < 0) {
			LOG_ERR("Sample read failed (ret=%d) motion_1s=%u", ret, period_motion);
		} else {
			LOG_INF("AXY t=%u seq=%u motion_1s=%u x_mg=%d y_mg=%d z_mg=%d temp_c=%d "
				"mag=%d int1=0x%02x vdd_mv=%d",
				k_uptime_get_32(), sample_seq, period_motion, x_mg, y_mg, z_mg,
				temp_c, magnet_state, int1_src, (int)vdd_mv);
		}

		if (period_motion > 0U) {
			leds_set(1);
			k_sleep(K_MSEC(50));
			leds_set(0);
		}

		sample_seq++;
		k_sleep(K_MSEC(SAMPLE_PERIOD_MS));
	}

	return 0;
}
```

## src/lis2dh12_zephyr.c
```c
#include "lis2dh12_zephyr.h"

#include <errno.h>
#include <string.h>

#include <zephyr/kernel.h>
#include <zephyr/logging/log.h>

#include "lis2dh12_reg.h"

LOG_MODULE_REGISTER(lis2dh12_zephyr, LOG_LEVEL_INF);

#define LIS2DH12_I2C_ADDR 0x19U

static struct lis2dh12_dev *g_dev;

static int platform_read(uint8_t reg, uint8_t *data, uint16_t len)
{
	if (!g_dev || !g_dev->initialized) {
		return -ENODEV;
	}

	if (len > 16U) {
		return -EINVAL;
	}

	if (len == 1U) {
		return i2c_write_read_dt(&g_dev->bus, &reg, 1, data, len);
	}

	uint8_t addr = reg | 0x80U;

	return i2c_write_read_dt(&g_dev->bus, &addr, 1, data, len);
}

static int platform_write(uint8_t reg, const uint8_t *data, uint16_t len)
{
	if (!g_dev || !g_dev->initialized) {
		return -ENODEV;
	}

	if (len > 16U) {
		return -EINVAL;
	}

	uint8_t buf[1U + 16U];

	buf[0] = (len == 1U) ? reg : (reg | 0x80U);
	memcpy(&buf[1], data, len);

	return i2c_write_dt(&g_dev->bus, buf, 1U + len);
}

int lis2dh12_zephyr_read_whoami(struct lis2dh12_dev *dev, uint8_t *whoami)
{
	if (!dev || !dev->initialized || !whoami) {
		return -EINVAL;
	}

	return platform_read(LIS2DH12_WHO_AM_I, whoami, 1);
}

int lis2dh12_zephyr_init(struct lis2dh12_dev *dev)
{
	if (!dev) {
		return -EINVAL;
	}

	dev->bus.bus = DEVICE_DT_GET(DT_ALIAS(i2c_bus));
	dev->bus.addr = LIS2DH12_I2C_ADDR;

	if (!device_is_ready(dev->bus.bus)) {
		LOG_ERR("LIS2DH12 I2C bus not ready");
		return -ENODEV;
	}

	dev->initialized = true;
	g_dev = dev;

	uint8_t whoami = 0;
	int ret = lis2dh12_zephyr_read_whoami(dev, &whoami);

	if (ret < 0) {
		return ret;
	}
	if (whoami != 0x33U) {
		LOG_ERR("Unexpected WHO_AM_I=0x%02x", whoami);
		return -ENODEV;
	}

	uint8_t ctrl_reg1 = 0x2F; /* 10Hz, LP mode, XYZ on */
	uint8_t ctrl_reg4 = 0x80;   /* BDU on, +-2g */
	uint8_t temp_cfg = 0xC0;    /* temperature enabled */

	ret = platform_write(0x20, &ctrl_reg1, 1);
	ret |= platform_write(0x23, &ctrl_reg4, 1);
	ret |= platform_write(0x1F, &temp_cfg, 1);
	if (ret < 0) {
		LOG_ERR("Failed LIS2DH12 base config");
		return ret;
	}

	k_sleep(K_MSEC(50));
	LOG_INF("LIS2DH12 ready WHO_AM_I=0x%02x I2C addr=0x%02x", whoami, LIS2DH12_I2C_ADDR);
	return 0;
}

int lis2dh12_zephyr_read_accel_mg(struct lis2dh12_dev *dev, int16_t *x_mg, int16_t *y_mg,
				  int16_t *z_mg)
{
	if (!dev || !dev->initialized || !x_mg || !y_mg || !z_mg) {
		return -EINVAL;
	}

	uint8_t raw[6] = {0};
	int ret = platform_read(0x28, raw, 6);

	if (ret < 0) {
		return ret;
	}

	*x_mg = (int16_t)((raw[1] << 8) | raw[0]);
	*y_mg = (int16_t)((raw[3] << 8) | raw[2]);
	*z_mg = (int16_t)((raw[5] << 8) | raw[4]);
	return 0;
}

int lis2dh12_zephyr_read_temp_c(struct lis2dh12_dev *dev, int8_t *temp_c)
{
	if (!dev || !dev->initialized || !temp_c) {
		return -EINVAL;
	}

	uint8_t temp_l = 0;
	uint8_t temp_h = 0;
	int ret = platform_read(0x0C, &temp_l, 1);

	ret |= platform_read(0x0D, &temp_h, 1);
	if (ret < 0) {
		return ret;
	}

	int16_t lsb = ((int16_t)temp_h << 8) | temp_l;

	*temp_c = (int8_t)lis2dh12_from_lsb_lp_to_celsius(lsb);
	return 0;
}

int lis2dh12_zephyr_config_motion(struct lis2dh12_dev *dev, uint8_t threshold, uint8_t duration)
{
	if (!dev || !dev->initialized) {
		return -EINVAL;
	}

	uint8_t ctrl1 = 0x57;    /* 100Hz XYZ on */
	uint8_t ctrl2 = 0x09;    /* HP filter on INT1 */
	uint8_t ctrl3 = 0x40;    /* route activity interrupt to INT1 */
	uint8_t ctrl4 = 0x00;    /* +-2g */
	uint8_t ctrl5 = 0x00;    /* non-latched INT1 */
	uint8_t int1_cfg = 0x2A; /* XH/YH/ZH OR */
	uint8_t reference = 0;
	uint8_t int1_src = 0;

	int ret = 0;

	ret |= platform_write(0x20, &ctrl1, 1);
	ret |= platform_write(0x21, &ctrl2, 1);
	ret |= platform_write(0x22, &ctrl3, 1);
	ret |= platform_write(0x23, &ctrl4, 1);
	ret |= platform_write(0x24, &ctrl5, 1);
	ret |= platform_write(0x32, &threshold, 1);
	ret |= platform_write(0x33, &duration, 1);
	ret |= platform_read(0x26, &reference, 1);
	ret |= platform_write(0x30, &int1_cfg, 1);
	ret |= platform_read(0x31, &int1_src, 1);
	if (ret < 0) {
		LOG_ERR("Failed motion setup");
		return ret;
	}

	LOG_INF("LIS2DH12 motion configured threshold=%u duration=%u", threshold, duration);
	return 0;
}

int lis2dh12_zephyr_power_down(struct lis2dh12_dev *dev)
{
	if (!dev || !dev->initialized) {
		return -EINVAL;
	}

	uint8_t ctrl1 = 0;
	int ret = platform_read(0x20, &ctrl1, 1);

	if (ret < 0) {
		return ret;
	}

	ctrl1 &= 0x0FU; /* ODR[3:0] = 0000: power-down mode. */
	ret = platform_write(0x20, &ctrl1, 1);
	if (ret < 0) {
		LOG_ERR("Failed LIS2DH12 power-down");
		return ret;
	}

	LOG_INF("LIS2DH12 powered down");
	return 0;
}

int lis2dh12_zephyr_read_int1_src(struct lis2dh12_dev *dev, uint8_t *int1_src)
{
	if (!dev || !dev->initialized || !int1_src) {
		return -EINVAL;
	}

	return platform_read(0x31, int1_src, 1);
}
```

## src/lis2dh12_zephyr.h
```c
#ifndef FLIGHTCAP_LIS2DH12_ZEPHYR_H
#define FLIGHTCAP_LIS2DH12_ZEPHYR_H

#include <stdbool.h>
#include <stdint.h>

#include <zephyr/drivers/i2c.h>

struct lis2dh12_dev {
	struct i2c_dt_spec bus;
	bool initialized;
};

int lis2dh12_zephyr_init(struct lis2dh12_dev *dev);
int lis2dh12_zephyr_read_whoami(struct lis2dh12_dev *dev, uint8_t *whoami);
int lis2dh12_zephyr_read_accel_mg(struct lis2dh12_dev *dev, int16_t *x_mg, int16_t *y_mg,
				  int16_t *z_mg);
int lis2dh12_zephyr_read_temp_c(struct lis2dh12_dev *dev, int8_t *temp_c);
int lis2dh12_zephyr_config_motion(struct lis2dh12_dev *dev, uint8_t threshold, uint8_t duration);
int lis2dh12_zephyr_power_down(struct lis2dh12_dev *dev);
int lis2dh12_zephyr_read_int1_src(struct lis2dh12_dev *dev, uint8_t *int1_src);

#endif
```
