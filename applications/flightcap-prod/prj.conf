## CMakeLists.txt
```
cmake_minimum_required(VERSION 3.20.0)

find_package(Zephyr REQUIRED HINTS $ENV{ZEPHYR_BASE})
project(flightcap_prod LANGUAGES C)

target_include_directories(app PRIVATE
    ${CMAKE_CURRENT_SOURCE_DIR}/src
    ${CMAKE_CURRENT_SOURCE_DIR}/../../lib/lis2dh12
    ${CMAKE_CURRENT_SOURCE_DIR}/../../lib/vl53l4cd
    ${CMAKE_CURRENT_SOURCE_DIR}/../../lib/flightcap_hw
    ${CMAKE_CURRENT_SOURCE_DIR}/../../lib/vbatt
    ${CMAKE_CURRENT_SOURCE_DIR}/../../lib/spi_nor
)

target_sources(app PRIVATE
    src/main.c
    src/prod_state.c
    src/telemetry_adv.c
    src/dfu_mode.c
    ${CMAKE_CURRENT_SOURCE_DIR}/../../lib/lis2dh12/lis2dh12_zephyr.c
    ${CMAKE_CURRENT_SOURCE_DIR}/../../lib/lis2dh12/lis2dh12_reg.c
    ${CMAKE_CURRENT_SOURCE_DIR}/../../lib/vl53l4cd/vl53l0x_zephyr.c
    ${CMAKE_CURRENT_SOURCE_DIR}/../../lib/vl53l4cd/tof_distance_filter.c
    ${CMAKE_CURRENT_SOURCE_DIR}/../../lib/vbatt/vbatt_zephyr.c
    ${CMAKE_CURRENT_SOURCE_DIR}/../../lib/flightcap_hw/flightcap_hw.c
)

if(CONFIG_SPI_NOR AND CONFIG_FLASH_JESD216_API)
  target_sources(app PRIVATE
    ${CMAKE_CURRENT_SOURCE_DIR}/../../lib/spi_nor/spi_nor_zephyr.c
  )
endif()
```

## sample.yaml
```
sample:
  name: FlightCap Prod (BLE beacon)
  description: >
    Non-connectable BLE manufacturer-data telemetry (ToF distance + motion
    interactions) on a 20 s duty cycle for FlightCap_nRF52833.

common:
  tags:
    - flightcap
    - prod
    - accelerometer
    - lis2dh12
    - i2c
    - vl53l0x
    - bluetooth

tests:
  applications.flightcap-prod:
    platform_allow:
      - FlightCap_nRF52833
    harness: console
```

## prj.conf
```kconfig
# FlightCap production firmware — non-connectable BLE manufacturer-data beacon
CONFIG_GPIO=y

# I2C is enabled in the FlightCap board defconfig (CONFIG_I2C / CONFIG_I2C_NRFX);
# &i2c0 provides SDA P0.05 / SCL P0.04 @ 100 kHz.

# VL53L0X time-of-flight via Zephyr sensor driver (st,vl53l0x @ 0x29).
CONFIG_SENSOR=y
CONFIG_VL53L0X=y

# Logging over RTT
CONFIG_LOG=y
CONFIG_LOG_DEFAULT_LEVEL=3
CONFIG_USE_SEGGER_RTT=y
CONFIG_RTT_CONSOLE=y
CONFIG_CONSOLE=y
CONFIG_SEGGER_RTT_MODE_NO_BLOCK_SKIP=y
CONFIG_UART_CONSOLE=n

# Bluetooth: non-connectable beacon in Run/Pair; connectable SMP DFU in DFU mode.
CONFIG_BT=y
CONFIG_BT_BROADCASTER=y
CONFIG_BT_PERIPHERAL=y
CONFIG_BT_MAX_CONN=1
# Keep a stable identity address for Run/Pair advertising (no RPA rotation).
CONFIG_BT_PRIVACY=n
# Short name: must fit in 31-byte scan response alongside SMP UUID in DFU mode.
CONFIG_BT_DEVICE_NAME="FCap"
CONFIG_BT_DEVICE_APPEARANCE=0
CONFIG_BT_HCI_ERR_TO_STR=y
CONFIG_BT_CTLR_TX_PWR_ANTENNA=8
CONFIG_BT_L2CAP_TX_MTU=247
CONFIG_BT_BUF_ACL_RX_SIZE=251
CONFIG_BT_BUF_ACL_TX_SIZE=251

# MCUmgr SMP-over-BLE DFU (magnet 10 s hold to enter, 3 s hold to exit).
CONFIG_NET_BUF=y
CONFIG_ZCBOR=y
CONFIG_CRC=y
CONFIG_STREAM_FLASH=y
CONFIG_IMG_MANAGER=y
CONFIG_MPU_ALLOW_FLASH_WRITE=y
CONFIG_MCUMGR=y
CONFIG_MCUMGR_GRP_IMG=y
CONFIG_MCUMGR_GRP_OS=y
CONFIG_MCUMGR_TRANSPORT_BT=y
CONFIG_MCUMGR_TRANSPORT_BT_REASSEMBLY=y
CONFIG_MCUMGR_TRANSPORT_NETBUF_SIZE=1024
CONFIG_MCUMGR_TRANSPORT_WORKQUEUE_STACK_SIZE=4096
CONFIG_HEAP_MEM_POOL_SIZE=8192
CONFIG_SYSTEM_WORKQUEUE_STACK_SIZE=2048

# SAADC VDD (flightcap_hw vbatt check at boot).
CONFIG_ADC=y

# Sleep jitter in Run mode (sys_rand32_get).
CONFIG_ENTROPY_GENERATOR=y

# MCUboot image slots (sysbuild; internal flash only).
CONFIG_FLASH=y
CONFIG_FLASH_PAGE_LAYOUT=y
CONFIG_FLASH_MAP=y

# External MX25R8035 not populated — disable SPI NOR driver (board DT node present).
CONFIG_SPI_NOR=n

# To log external flash present/absent at boot, enable both:
# CONFIG_SPI_NOR=y
# CONFIG_FLASH_JESD216_API=y

CONFIG_MAIN_STACK_SIZE=6144
```

## src/main.c
```c
#include <errno.h>

#include <zephyr/bluetooth/bluetooth.h>
#include <zephyr/device.h>
#include <zephyr/devicetree.h>
#include <zephyr/drivers/gpio.h>
#include <zephyr/kernel.h>
#include <zephyr/logging/log.h>

#include "flightcap_hw.h"
#include "lis2dh12_zephyr.h"
#include "prod_state.h"

LOG_MODULE_REGISTER(flightcap_prod, LOG_LEVEL_INF);

#define ACCEL_INT_NODE DT_ALIAS(accel_int)
#define ACCEL_INT2_NODE DT_ALIAS(accel_int2)
#define MAGNET_NODE DT_ALIAS(magnet_sensor)
#define LED0_NODE DT_ALIAS(led0)
#define LED1_NODE DT_ALIAS(led1)
#define I2C_NODE DT_ALIAS(i2c_bus)

#define MOTION_THRESHOLD_MG 3
#define MOTION_DURATION_SAMPLES 0

static const struct gpio_dt_spec led0 = GPIO_DT_SPEC_GET(LED0_NODE, gpios);
static const struct gpio_dt_spec led1 = GPIO_DT_SPEC_GET(LED1_NODE, gpios);
static const struct gpio_dt_spec magnet = GPIO_DT_SPEC_GET(MAGNET_NODE, gpios);
static const struct gpio_dt_spec accel_int = GPIO_DT_SPEC_GET(ACCEL_INT_NODE, gpios);
static const struct gpio_dt_spec accel_int2 = GPIO_DT_SPEC_GET(ACCEL_INT2_NODE, gpios);
static const struct device *const i2c_dev = DEVICE_DT_GET(I2C_NODE);
static const struct device *tof_dev;

static struct gpio_callback accel_int_cb;
static struct gpio_callback accel_int2_cb;
static volatile uint32_t interactions;
static volatile bool orientation_irq_pending;
static struct lis2dh12_dev lis2dh12;

static void accel_int_callback(const struct device *port, struct gpio_callback *cb, uint32_t pins)
{
	ARG_UNUSED(port);
	ARG_UNUSED(cb);
	ARG_UNUSED(pins);

	interactions++;
}

static void accel_int2_callback(const struct device *port, struct gpio_callback *cb, uint32_t pins)
{
	ARG_UNUSED(port);
	ARG_UNUSED(cb);
	ARG_UNUSED(pins);

	orientation_irq_pending = true;
}

int main(void)
{
	int ret;
	struct prod_context ctx = {
		.lis2dh = &lis2dh12,
		.tof_dev = NULL,
		.led0 = &led0,
		.led1 = &led1,
		.magnet = &magnet,
		.accel_int = &accel_int,
		.accel_int2 = &accel_int2,
		.accel_int_cb = &accel_int_cb,
		.accel_int2_cb = &accel_int2_cb,
		.interactions = &interactions,
		.orientation_irq_pending = &orientation_irq_pending,
		.pair_active = false,
		.dfu_active = false,
		.bt_was_disabled = false,
		.cycle = 0U,
	};

	if (!gpio_is_ready_dt(&led0) || !gpio_is_ready_dt(&led1) ||
	    !gpio_is_ready_dt(&magnet) || !gpio_is_ready_dt(&accel_int) ||
	    !gpio_is_ready_dt(&accel_int2)) {
		LOG_ERR("GPIO dependency not ready");
		return -ENODEV;
	}

	if (!device_is_ready(i2c_dev)) {
		LOG_ERR("I2C bus not ready");
		return -ENODEV;
	}

	ret = gpio_pin_configure_dt(&led0, GPIO_OUTPUT_INACTIVE);
	ret |= gpio_pin_configure_dt(&led1, GPIO_OUTPUT_INACTIVE);
	ret |= gpio_pin_configure_dt(&magnet, GPIO_INPUT);
	if (ret < 0) {
		LOG_ERR("GPIO configuration failed (%d)", ret);
		return ret;
	}

	{
		struct flightcap_hw_status hw = {0};

		(void)flightcap_hw_check(FLIGHTCAP_HW_VBATT | FLIGHTCAP_HW_ACCEL | FLIGHTCAP_HW_TOF |
					 FLIGHTCAP_HW_FLASH, &hw);
		if (hw.tof_ok) {
			tof_dev = DEVICE_DT_GET(DT_ALIAS(tof_sensor));
			ctx.tof_dev = tof_dev;
			LOG_INF("VL53L0X ready at boot (probe_mm=%u)", hw.tof_probe_mm);
		} else {
			LOG_WRN("VL53L0X not available — distance invalid in beacon");
		}
#if IS_ENABLED(CONFIG_SPI_NOR)
		if (hw.flash_ok) {
			LOG_INF("SPI NOR present");
		} else {
			LOG_INF("SPI NOR absent — continuing without external flash");
		}
#endif
	}

	ret = gpio_pin_configure_dt(&accel_int, GPIO_INPUT);
	ret |= gpio_pin_configure_dt(&accel_int2, GPIO_INPUT);
	if (ret < 0) {
		LOG_ERR("accel INT GPIO configure failed (%d)", ret);
		return ret;
	}

	ret = lis2dh12_zephyr_init(&lis2dh12);
	if (ret < 0) {
		LOG_ERR("LIS2DH12 init failed (%d)", ret);
		return ret;
	}

	ret = lis2dh12_zephyr_config_motion_and_orientation(&lis2dh12, MOTION_THRESHOLD_MG,
							    MOTION_DURATION_SAMPLES);
	if (ret < 0) {
		LOG_ERR("LIS2DH12 motion+orientation config failed (%d)", ret);
		return ret;
	}

	gpio_init_callback(&accel_int_cb, accel_int_callback, BIT(accel_int.pin));
	ret = gpio_add_callback(accel_int.port, &accel_int_cb);
	ret |= gpio_pin_interrupt_configure_dt(&accel_int, GPIO_INT_EDGE_TO_ACTIVE);
	if (ret < 0) {
		LOG_ERR("INT1 callback setup failed (%d)", ret);
		return ret;
	}

	gpio_init_callback(&accel_int2_cb, accel_int2_callback, BIT(accel_int2.pin));
	ret = gpio_add_callback(accel_int2.port, &accel_int2_cb);
	ret |= gpio_pin_interrupt_configure_dt(&accel_int2, GPIO_INT_EDGE_TO_ACTIVE);
	if (ret < 0) {
		LOG_ERR("INT2 callback setup failed (%d)", ret);
		return ret;
	}

	ret = bt_enable(NULL);
	if (ret != 0) {
		LOG_ERR("bt_enable failed (%d)", ret);
		return ret;
	}

	LOG_INF("FlightCap prod state machine starting");
	prod_run(&ctx);

	return 0;
}
```

## src/dfu_mode.c
```c
#include "dfu_mode.h"

#include <zephyr/bluetooth/bluetooth.h>
#include <zephyr/bluetooth/conn.h>
#include <zephyr/bluetooth/hci.h>
#include <zephyr/logging/log.h>
#include <zephyr/mgmt/mcumgr/transport/smp_bt.h>
#include <zephyr/sys/util.h>

LOG_MODULE_REGISTER(dfu_mode, LOG_LEVEL_INF);

#define DFU_ADV_INT_MIN 0x0320U /* 500 ms */
#define DFU_ADV_INT_MAX 0x0320U

#define DEVICE_NAME CONFIG_BT_DEVICE_NAME
#define DEVICE_NAME_LEN (sizeof(DEVICE_NAME) - 1U)

static struct bt_conn *dfu_conn;
static bool dfu_adv_running;

/*
 * SMP UUID in primary AD; device name in scan response only.
 * Both fields must fit in separate 31-byte legacy AD buffers.
 */
static const struct bt_data dfu_ad[] = {
	BT_DATA_BYTES(BT_DATA_FLAGS, (BT_LE_AD_GENERAL | BT_LE_AD_NO_BREDR)),
	BT_DATA_BYTES(BT_DATA_UUID128_ALL, SMP_BT_SVC_UUID_VAL),
};

static const struct bt_data dfu_sd[] = {
	BT_DATA(BT_DATA_NAME_COMPLETE, DEVICE_NAME, DEVICE_NAME_LEN),
};

#define AD_ELEM_ON_AIR_LEN(payload_len) (2U + (payload_len))
#define DFU_PRIMARY_ON_AIR_LEN                                                             \
	(AD_ELEM_ON_AIR_LEN(1U) + AD_ELEM_ON_AIR_LEN(BT_UUID_SIZE_128))
#define DFU_SCAN_RSP_ON_AIR_LEN AD_ELEM_ON_AIR_LEN(DEVICE_NAME_LEN)

BUILD_ASSERT(DFU_PRIMARY_ON_AIR_LEN <= BT_GAP_ADV_MAX_ADV_DATA_LEN);
BUILD_ASSERT(DFU_SCAN_RSP_ON_AIR_LEN <= BT_GAP_ADV_MAX_ADV_DATA_LEN);

static const struct bt_le_adv_param dfu_adv_param =
	BT_LE_ADV_PARAM_INIT(BT_LE_ADV_OPT_CONN, DFU_ADV_INT_MIN, DFU_ADV_INT_MAX, NULL);

static void dfu_connected(struct bt_conn *conn, uint8_t err)
{
	if (err != 0) {
		LOG_WRN("DFU connect failed (%u)", err);
		return;
	}

	if (dfu_conn != NULL) {
		bt_conn_unref(dfu_conn);
	}

	dfu_conn = bt_conn_ref(conn);
	LOG_INF("DFU central connected");
}

static void dfu_disconnected(struct bt_conn *conn, uint8_t reason)
{
	ARG_UNUSED(reason);

	if (dfu_conn == conn) {
		bt_conn_unref(dfu_conn);
		dfu_conn = NULL;
	}

	LOG_INF("DFU central disconnected");
}

BT_CONN_CB_DEFINE(dfu_conn_cb) = {
	.connected = dfu_connected,
	.disconnected = dfu_disconnected,
};

static int dfu_adv_start(void)
{
	int ret;

	if (dfu_adv_running) {
		return 0;
	}

	ret = bt_le_adv_start(&dfu_adv_param, dfu_ad, ARRAY_SIZE(dfu_ad), dfu_sd, ARRAY_SIZE(dfu_sd));
	if (ret < 0) {
		LOG_ERR("DFU adv start failed (%d)", ret);
		return ret;
	}

	dfu_adv_running = true;
	LOG_INF("DFU SMP advertising started (connectable, name \"%s\")", DEVICE_NAME);
	return 0;
}

static int dfu_adv_stop(void)
{
	int ret = 0;

	if (dfu_conn != NULL) {
		(void)bt_conn_disconnect(dfu_conn, BT_HCI_ERR_REMOTE_USER_TERM_CONN);
	}

	if (dfu_adv_running) {
		ret = bt_le_adv_stop();
		dfu_adv_running = false;
		if (ret < 0) {
			LOG_ERR("DFU adv stop failed (%d)", ret);
			return ret;
		}
	}

	return ret;
}

int dfu_mode_enter(struct prod_context *ctx)
{
	int ret;

	ARG_UNUSED(ctx);

	ret = dfu_adv_start();
	if (ret < 0) {
		return ret;
	}

	return 0;
}

int dfu_mode_exit(struct prod_context *ctx)
{
	ARG_UNUSED(ctx);

	return dfu_adv_stop();
}
```

## src/dfu_mode.h
```c
#ifndef DFU_MODE_H
#define DFU_MODE_H

#include "prod_state.h"

int dfu_mode_enter(struct prod_context *ctx);
int dfu_mode_exit(struct prod_context *ctx);

#endif
```

## src/prod_state.h
```c
#ifndef PROD_STATE_H
#define PROD_STATE_H

#include <stdbool.h>
#include <stdint.h>

#include <zephyr/device.h>
#include <zephyr/drivers/gpio.h>

#include "lis2dh12_zephyr.h"

enum prod_mode {
	PROD_MODE_RUN,
	PROD_MODE_SHELF,
	PROD_MODE_PAIR,
	PROD_MODE_DFU,
};

struct prod_context {
	struct lis2dh12_dev *lis2dh;
	const struct device *tof_dev;
	const struct gpio_dt_spec *led0;
	const struct gpio_dt_spec *led1;
	const struct gpio_dt_spec *magnet;
	const struct gpio_dt_spec *accel_int;
	const struct gpio_dt_spec *accel_int2;
	struct gpio_callback *accel_int_cb;
	struct gpio_callback *accel_int2_cb;
	volatile uint32_t *interactions;
	volatile bool *orientation_irq_pending;
	bool pair_active;
	bool dfu_active;
	bool bt_was_disabled;
	uint32_t cycle;
};

void prod_run(struct prod_context *ctx);

#endif
```

## src/telemetry_adv.c
```c
#include "telemetry_adv.h"

#include <string.h>

#include <zephyr/bluetooth/bluetooth.h>
#include <zephyr/bluetooth/hci.h>
#include <zephyr/logging/log.h>
#include <zephyr/sys/util.h>

LOG_MODULE_REGISTER(telemetry_adv, LOG_LEVEL_INF);

#define ADV_INTERVAL_BASE_UNITS 0x00A0U /* 100 ms (0.625 ms units) */
#define ADV_INTERVAL_DITHER_UNIT 0x0020U /* 25 ms per step, max +175 ms */

#define DEVICE_NAME CONFIG_BT_DEVICE_NAME
#define DEVICE_NAME_LEN (sizeof(DEVICE_NAME) - 1U)

static TelemetryAdv adv_payload = {
	.company_id = TELEM_ADV_COMPANY_ID,
	.magic = TELEM_ADV_MAGIC,
	.version = TELEM_ADV_VERSION,
};

static int16_t last_distance_mm = INT16_MIN;
static uint16_t last_interactions;
static uint16_t last_vbatt_mv;
static bool adv_running;
static bool device_addr_logged;
static struct bt_le_adv_param adv_param;
static uint16_t adv_interval_units;

static void telemetry_adv_param_update(void)
{
	uint16_t dither = (uint16_t)(((uint32_t)adv_payload.device_addr[5] & 0x07U) *
				       ADV_INTERVAL_DITHER_UNIT);

	adv_interval_units = ADV_INTERVAL_BASE_UNITS + dither;
	adv_param = (struct bt_le_adv_param)BT_LE_ADV_PARAM_INIT(
		BT_LE_ADV_OPT_USE_IDENTITY | BT_LE_ADV_OPT_SCANNABLE, adv_interval_units,
		adv_interval_units, NULL);
}

static void telemetry_refresh_device_addr(void)
{
	bt_addr_le_t addrs[1];
	size_t count = 1;

	bt_id_get(addrs, &count);
	if (count == 0U) {
		memset(adv_payload.device_addr, 0, sizeof(adv_payload.device_addr));
		return;
	}

	memcpy(adv_payload.device_addr, addrs[0].a.val, sizeof(adv_payload.device_addr));
	telemetry_adv_param_update();

	if (!device_addr_logged) {
		LOG_INF("telemetry device_addr %02X:%02X:%02X:%02X:%02X:%02X",
			adv_payload.device_addr[0], adv_payload.device_addr[1],
			adv_payload.device_addr[2], adv_payload.device_addr[3],
			adv_payload.device_addr[4], adv_payload.device_addr[5]);
		device_addr_logged = true;
	}
}

/*
 * Primary AD: flags + manufacturer telemetry only (passive-scan friendly).
 * Device name goes in scan response (scannable non-connectable ADV_SCAN_IND).
 */
static struct bt_data ad[] = {
	BT_DATA_BYTES(BT_DATA_FLAGS, (BT_LE_AD_GENERAL | BT_LE_AD_NO_BREDR)),
	BT_DATA(BT_DATA_MANUFACTURER_DATA, (uint8_t *)&adv_payload, sizeof(adv_payload)),
};

static const struct bt_data sd[] = {
	BT_DATA(BT_DATA_NAME_COMPLETE, DEVICE_NAME, DEVICE_NAME_LEN),
};

/* On-air AD element size: 1 len + 1 type + payload. */
#define AD_ELEM_ON_AIR_LEN(payload_len) (2U + (payload_len))
#define ADV_PRIMARY_ON_AIR_LEN                                                             \
	(AD_ELEM_ON_AIR_LEN(1U) + AD_ELEM_ON_AIR_LEN(sizeof(TelemetryAdv)))
#define ADV_SCAN_RSP_ON_AIR_LEN AD_ELEM_ON_AIR_LEN(DEVICE_NAME_LEN)

BUILD_ASSERT(ADV_PRIMARY_ON_AIR_LEN <= BT_GAP_ADV_MAX_ADV_DATA_LEN);
BUILD_ASSERT(ADV_SCAN_RSP_ON_AIR_LEN <= BT_GAP_ADV_MAX_ADV_DATA_LEN);

static void telemetry_adv_param_init(void)
{
	memset(adv_payload.device_addr, 0, sizeof(adv_payload.device_addr));
	telemetry_adv_param_update();
}

int telemetry_adv_publish(int16_t distance_mm, uint16_t interactions, uint16_t vbatt_mv,
			  uint8_t flags)
{
	bool changed = (distance_mm != last_distance_mm) || (interactions != last_interactions) ||
		       (vbatt_mv != last_vbatt_mv);

	adv_payload.distance_mm = distance_mm;
	adv_payload.interactions = interactions;
	adv_payload.vbatt_mv = vbatt_mv;
	adv_payload.flags = flags;

	if (changed) {
		adv_payload.seq++;
		last_distance_mm = distance_mm;
		last_interactions = interactions;
		last_vbatt_mv = vbatt_mv;
	}

	if (!adv_running) {
		return 0;
	}

	int err = bt_le_adv_update_data(ad, ARRAY_SIZE(ad), sd, ARRAY_SIZE(sd));

	if (err != 0) {
		LOG_ERR("bt_le_adv_update_data failed (%d)", err);
		return err;
	}

	return 0;
}

int telemetry_adv_start(void)
{
	int err;

	if (adv_running) {
		return 0;
	}

	telemetry_refresh_device_addr();

	err = bt_le_adv_start(&adv_param, ad, ARRAY_SIZE(ad), sd, ARRAY_SIZE(sd));
	if (err != 0) {
		LOG_ERR("bt_le_adv_start failed (%d)", err);
		return err;
	}

	adv_running = true;
	LOG_INF("BLE beacon started (non-conn scannable, %u ms interval, name \"%s\")",
		(adv_interval_units * 625U) / 1000U, DEVICE_NAME);
	return 0;
}

int telemetry_adv_stop(void)
{
	int err = 0;

	if (!adv_running) {
		return 0;
	}

	err = bt_le_adv_stop();
	adv_running = false;
	if (err != 0) {
		LOG_ERR("bt_le_adv_stop failed (%d)", err);
		return err;
	}

	return 0;
}

void telemetry_adv_bt_disabled(void)
{
	adv_running = false;
	device_addr_logged = false;
	memset(adv_payload.device_addr, 0, sizeof(adv_payload.device_addr));
	telemetry_adv_param_init();
}

void telemetry_adv_get_device_addr(uint8_t addr[6])
{
	if (addr == NULL) {
		return;
	}

	memcpy(addr, adv_payload.device_addr, 6U);
}

bool telemetry_adv_active(void)
{
	return adv_running;
}

uint16_t telemetry_adv_seq(void)
{
	return adv_payload.seq;
}
```

## src/telemetry_adv.h
```c
#ifndef TELEMETRY_ADV_H
#define TELEMETRY_ADV_H

#include <stdbool.h>
#include <stdint.h>

#include <zephyr/sys/util.h>

/*
 * Provisional Bluetooth manufacturer company ID for Neurotech Hub (WashU).
 * ASCII 'N' | ('H' << 8) — replace with a Bluetooth SIG assigned ID before
 * field deployment outside the lab.
 */
#define TELEM_ADV_COMPANY_ID 0x4E48U // NH
#define TELEM_ADV_MAGIC 0xA5U
#define TELEM_ADV_VERSION 0x03U

#define TELEM_FLAG_DIST_VALID BIT(0)
#define TELEM_FLAG_INTERACT_VALID BIT(1)
#define TELEM_FLAG_TOF_ERR BIT(2)
#define TELEM_FLAG_STALE          BIT(3)
#define TELEM_FLAG_PAIR_MODE      BIT(4)
#define TELEM_FLAG_VBATT_VALID    BIT(5)

#pragma pack(push, 1)
typedef struct
{
	uint16_t company_id;
	uint8_t magic;
	uint8_t version;
	uint8_t device_addr[6]; /* BLE identity address (stable per device; MSB format) */
	uint16_t seq;
	int16_t distance_mm;
	uint16_t interactions;
	uint8_t flags;
	uint16_t vbatt_mv;
} TelemetryAdv;
#pragma pack(pop)

int telemetry_adv_publish(int16_t distance_mm, uint16_t interactions, uint16_t vbatt_mv,
			  uint8_t flags);
int telemetry_adv_start(void);
int telemetry_adv_stop(void);
void telemetry_adv_bt_disabled(void);
void telemetry_adv_get_device_addr(uint8_t addr[6]);
bool telemetry_adv_active(void);
uint16_t telemetry_adv_seq(void);

#endif
```

## src/vl53l4cd_filter.c
```c
#include "vl53l4cd_filter.h"

#include <errno.h>
#include <string.h>

#include <zephyr/kernel.h>

static K_MUTEX_DEFINE(filter_mu);

static uint16_t buf_data[VL53L4CD_FILTER_CAP];
static uint16_t buf_head;  /* index of next slot to write */
static uint16_t buf_count; /* number of valid entries (0..CAP) */

void vl53l4cd_filter_init(void)
{
	vl53l4cd_filter_clear();
}

void vl53l4cd_filter_push(uint16_t mm)
{
	k_mutex_lock(&filter_mu, K_FOREVER);
	buf_data[buf_head] = mm;
	buf_head = (uint16_t)((buf_head + 1U) % VL53L4CD_FILTER_CAP);
	if (buf_count < VL53L4CD_FILTER_CAP) {
		buf_count++;
	}
	k_mutex_unlock(&filter_mu);
}

void vl53l4cd_filter_clear(void)
{
	k_mutex_lock(&filter_mu, K_FOREVER);
	buf_head = 0;
	buf_count = 0;
	k_mutex_unlock(&filter_mu);
}

int vl53l4cd_filter_snapshot(uint16_t *out_mm, uint16_t *out_count)
{
	uint16_t scratch[VL53L4CD_FILTER_CAP];
	uint16_t n;

	if (!out_mm || !out_count) {
		return -EINVAL;
	}

	/*
	 * Take a quick snapshot under the lock, then sort/average outside the
	 * critical section so we never block the reader thread while doing
	 * O(N^2) insertion sort.
	 *
	 * When buf_count < CAP, valid entries live at buf_data[0..count-1].
	 * When buf_count == CAP the ring is full and every slot is valid (the
	 * order is shuffled by circular writes, but order doesn't matter for
	 * sort + trimmed mean).
	 */
	k_mutex_lock(&filter_mu, K_FOREVER);
	n = buf_count;
	if (n > 0) {
		memcpy(scratch, buf_data, (size_t)n * sizeof(buf_data[0]));
	}
	k_mutex_unlock(&filter_mu);

	*out_count = n;
	if (n < VL53L4CD_FILTER_MIN_VALID) {
		return -EAGAIN;
	}

	for (uint16_t i = 1; i < n; i++) {
		uint16_t key = scratch[i];
		int j = (int)i - 1;

		while (j >= 0 && scratch[j] > key) {
			scratch[j + 1] = scratch[j];
			j--;
		}
		scratch[j + 1] = key;
	}

	uint16_t trim = (uint16_t)((uint32_t)n * VL53L4CD_FILTER_TRIM_NUM /
				   VL53L4CD_FILTER_TRIM_DEN);
	uint16_t lo = trim;
	uint16_t hi = (uint16_t)(n - trim);

	if (hi <= lo) {
		/* Degenerate (shouldn't happen at n >= 4 / trim 1/5) — median. */
		lo = (uint16_t)(n / 2U);
		hi = (uint16_t)(lo + 1U);
	}

	uint32_t sum = 0;
	for (uint16_t i = lo; i < hi; i++) {
		sum += scratch[i];
	}

	*out_mm = (uint16_t)(sum / (uint32_t)(hi - lo));
	return 0;
}
```

## src/vl53l4cd_filter.h
```c
#ifndef FLIGHTCAP_VL53L4CD_FILTER_H
#define FLIGHTCAP_VL53L4CD_FILTER_H

#include <stdint.h>

/*
 * Rolling, trimmed-mean filter for VL53L4CD samples.
 *
 * The reader thread pushes valid millimeter readings into a fixed-capacity
 * circular buffer. The main 1 s loop calls snapshot() to grab a sorted
 * trimmed mean across the currently buffered samples (drop top/bottom
 * VL53L4CD_FILTER_TRIM_NUM/VL53L4CD_FILTER_TRIM_DEN, average the middle).
 *
 * - Same trimmed-mean shape as the Arduino reference, but non-draining so
 *   the main loop can sample it at any cadence without starving the reader.
 * - Mutex-protected so push() (background thread) and snapshot() (main
 *   thread) can race safely.
 */
#define VL53L4CD_FILTER_CAP       16   /* rolling buffer capacity */
#define VL53L4CD_FILTER_MIN_VALID 4    /* require >= 4 samples to return a value */
#define VL53L4CD_FILTER_TRIM_NUM  1    /* trim 1/5 of samples top and bottom */
#define VL53L4CD_FILTER_TRIM_DEN  5

/** Idempotent. Safe to call before or after K_MUTEX_DEFINE initialization. */
void vl53l4cd_filter_init(void);

/** Append a valid millimeter sample (overwrites oldest when full). */
void vl53l4cd_filter_push(uint16_t mm);

/** Drop all buffered samples — used on wake-from-sleep. */
void vl53l4cd_filter_clear(void);

/**
 * Snapshot the current trimmed-mean and sample count.
 *
 * @param out_mm     [out] Filtered millimeter value (only written on success).
 * @param out_count  [out] Number of samples present at snapshot time (always written).
 *
 * @retval 0        Success.
 * @retval -EAGAIN  Fewer than VL53L4CD_FILTER_MIN_VALID samples buffered.
 */
int vl53l4cd_filter_snapshot(uint16_t *out_mm, uint16_t *out_count);

#endif /* FLIGHTCAP_VL53L4CD_FILTER_H */
```

## src/vl53l4cd_zephyr.c
```c
/*
 * VL53L4CD ToF distance sensor driver — Zephyr port of the relevant subset
 * of Pololu's Arduino library (which itself is derived from ST's Ultra Lite
 * Driver, STSW-IMG026). The default 88-byte configuration block at
 * 0x30..0x87 is byte-identical to the Pololu source for easy auditing.
 */

#include "vl53l4cd_zephyr.h"

#include <errno.h>
#include <string.h>

#include <zephyr/drivers/i2c.h>
#include <zephyr/kernel.h>
#include <zephyr/logging/log.h>
#include <zephyr/sys/util.h>

LOG_MODULE_REGISTER(vl53l4cd, LOG_LEVEL_INF);

/* ------------------------------------------------------------------------- */
/* Register addresses (subset of ST ULD constants).                           */
/* ------------------------------------------------------------------------- */
#define VL53L4CD_OSC_FREQUENCY                     0x0006
#define VL53L4CD_VHV_CONFIG_TIMEOUT_MACROP_LOOP_BD 0x0008
#define VL53L4CD_GPIO_HV_MUX_CTRL                  0x0030
#define VL53L4CD_GPIO_TIO_HV_STATUS                0x0031
#define VL53L4CD_RANGE_CONFIG_A                    0x005E
#define VL53L4CD_RANGE_CONFIG_B                    0x0061
#define VL53L4CD_INTERMEASUREMENT_MS               0x006C
#define VL53L4CD_SYSTEM_INTERRUPT_CLEAR            0x0086
#define VL53L4CD_SYSTEM_START                      0x0087
#define VL53L4CD_RESULT_RANGE_STATUS               0x0089
#define VL53L4CD_RESULT_OSC_CALIBRATE_VAL          0x00DE
#define VL53L4CD_FIRMWARE_SYSTEM_STATUS            0x00E5
#define VL53L4CD_IDENTIFICATION_MODEL_ID           0x010F

#define VL53L4CD_MODEL_ID                          0xEBAA

/* Timeouts for polled waits in init(). */
#define VL53L4CD_BOOT_TIMEOUT_MS                   100
#define VL53L4CD_VHV_TIMEOUT_MS                    100

/*
 * ULD default configuration block written at 0x30..0x87 during init().
 * Byte-identical to Pololu's VL53L4CD_DEFAULT_CONFIGURATION[].
 */
static const uint8_t vl53l4cd_default_config[88] = {
	0x11, /* 0x30 : bit 4 = 1 -> active-low INT */
	0x02, /* 0x31 */
	0x00, /* 0x32 */
	0x02, /* 0x33 */
	0x08, /* 0x34 */
	0x00, /* 0x35 */
	0x08, /* 0x36 */
	0x10, /* 0x37 */
	0x01, /* 0x38 */
	0x01, /* 0x39 */
	0x00, /* 0x3a */
	0x00, /* 0x3b */
	0x00, /* 0x3c */
	0x00, /* 0x3d */
	0xff, /* 0x3e */
	0x00, /* 0x3f */
	0x0F, /* 0x40 */
	0x00, /* 0x41 */
	0x00, /* 0x42 */
	0x00, /* 0x43 */
	0x00, /* 0x44 */
	0x00, /* 0x45 */
	0x20, /* 0x46 : interrupt config — new sample ready */
	0x0b, /* 0x47 */
	0x00, /* 0x48 */
	0x00, /* 0x49 */
	0x02, /* 0x4a */
	0x14, /* 0x4b */
	0x21, /* 0x4c */
	0x00, /* 0x4d */
	0x00, /* 0x4e */
	0x05, /* 0x4f */
	0x00, /* 0x50 */
	0x00, /* 0x51 */
	0x00, /* 0x52 */
	0x00, /* 0x53 */
	0xc8, /* 0x54 */
	0x00, /* 0x55 */
	0x00, /* 0x56 */
	0x38, /* 0x57 */
	0xff, /* 0x58 */
	0x01, /* 0x59 */
	0x00, /* 0x5a */
	0x08, /* 0x5b */
	0x00, /* 0x5c */
	0x00, /* 0x5d */
	0x01, /* 0x5e */
	0xcc, /* 0x5f */
	0x07, /* 0x60 */
	0x01, /* 0x61 */
	0xf1, /* 0x62 */
	0x05, /* 0x63 */
	0x00, /* 0x64 : sigma threshold MSB (default 90 mm) */
	0xa0, /* 0x65 : sigma threshold LSB */
	0x00, /* 0x66 : min count rate MSB */
	0x80, /* 0x67 : min count rate LSB */
	0x08, /* 0x68 */
	0x38, /* 0x69 */
	0x00, /* 0x6a */
	0x00, /* 0x6b */
	0x00, /* 0x6c : inter-measurement period MSB */
	0x00, /* 0x6d */
	0x0f, /* 0x6e */
	0x89, /* 0x6f : inter-measurement period LSB */
	0x00, /* 0x70 */
	0x00, /* 0x71 */
	0x00, /* 0x72 */
	0x00, /* 0x73 */
	0x00, /* 0x74 */
	0x00, /* 0x75 */
	0x00, /* 0x76 */
	0x01, /* 0x77 */
	0x07, /* 0x78 */
	0x05, /* 0x79 */
	0x06, /* 0x7a */
	0x06, /* 0x7b */
	0x00, /* 0x7c */
	0x00, /* 0x7d */
	0x02, /* 0x7e */
	0xc7, /* 0x7f */
	0xff, /* 0x80 */
	0x9B, /* 0x81 */
	0x00, /* 0x82 */
	0x00, /* 0x83 */
	0x00, /* 0x84 */
	0x01, /* 0x85 */
	0x00, /* 0x86 : clear interrupt */
	0x00, /* 0x87 : start ranging (0 = off, 0x40 = autonomous, 0x21 = continuous) */
};

/*
 * Pololu/ULD raw status code remap. Index = (RESULT_RANGE_STATUS[0] & 0x1F),
 * value = documented status (0 == valid measurement). 255 = undocumented.
 */
static const uint8_t vl53l4cd_status_rtn[24] = {
	255, 255, 255, 5, 2, 4, 1, 7, 3,
	0,   255, 255, 9, 13, 255, 255, 255, 255, 10, 6,
	255, 255, 11, 12,
};

/* ------------------------------------------------------------------------- */
/* Low-level register I/O with 16-bit register addresses (MSB first).         */
/* ------------------------------------------------------------------------- */

static int reg_read(struct vl53l4cd_dev *dev, uint16_t reg, uint8_t *buf, size_t len)
{
	uint8_t addr_be[2] = { (uint8_t)(reg >> 8), (uint8_t)(reg & 0xFF) };

	return i2c_write_read(dev->i2c, dev->addr, addr_be, sizeof(addr_be), buf, len);
}

static int reg_write(struct vl53l4cd_dev *dev, uint16_t reg, const uint8_t *data, size_t len)
{
	uint8_t buf[2 + 32];

	if (len > sizeof(buf) - 2) {
		return -EINVAL;
	}
	buf[0] = (uint8_t)(reg >> 8);
	buf[1] = (uint8_t)(reg & 0xFF);
	memcpy(&buf[2], data, len);

	return i2c_write(dev->i2c, buf, 2 + len, dev->addr);
}

static int read_u8(struct vl53l4cd_dev *dev, uint16_t reg, uint8_t *val)
{
	return reg_read(dev, reg, val, 1);
}

static int read_u16(struct vl53l4cd_dev *dev, uint16_t reg, uint16_t *val)
{
	uint8_t b[2];
	int err = reg_read(dev, reg, b, sizeof(b));

	if (err == 0) {
		*val = ((uint16_t)b[0] << 8) | b[1];
	}
	return err;
}

static int read_u32(struct vl53l4cd_dev *dev, uint16_t reg, uint32_t *val)
{
	uint8_t b[4];
	int err = reg_read(dev, reg, b, sizeof(b));

	if (err == 0) {
		*val = ((uint32_t)b[0] << 24) | ((uint32_t)b[1] << 16) |
		       ((uint32_t)b[2] << 8) | b[3];
	}
	return err;
}

static int write_u8(struct vl53l4cd_dev *dev, uint16_t reg, uint8_t val)
{
	return reg_write(dev, reg, &val, 1);
}

static int write_u16(struct vl53l4cd_dev *dev, uint16_t reg, uint16_t val)
{
	uint8_t b[2] = { (uint8_t)(val >> 8), (uint8_t)(val & 0xFF) };

	return reg_write(dev, reg, b, sizeof(b));
}

static int write_u32(struct vl53l4cd_dev *dev, uint16_t reg, uint32_t val)
{
	uint8_t b[4] = {
		(uint8_t)(val >> 24), (uint8_t)(val >> 16),
		(uint8_t)(val >> 8),  (uint8_t)(val & 0xFF),
	};

	return reg_write(dev, reg, b, sizeof(b));
}

/* ------------------------------------------------------------------------- */
/* Public API.                                                                */
/* ------------------------------------------------------------------------- */

int vl53l4cd_data_ready(struct vl53l4cd_dev *dev, bool *ready)
{
	uint8_t status;
	int err;

	if (!dev || !dev->initialized || !ready) {
		return -EINVAL;
	}

	/*
	 * The ULD default config (0x30 byte) puts INT into active-low mode.
	 * GPIO_TIO_HV_STATUS bit 0 reflects the current INT line state; data
	 * is ready when the line is electrically LOW (bit 0 == 0).
	 */
	err = read_u8(dev, VL53L4CD_GPIO_TIO_HV_STATUS, &status);
	if (err != 0) {
		return err;
	}

	*ready = ((status & 0x01) == 0);
	return 0;
}

int vl53l4cd_clear_interrupt(struct vl53l4cd_dev *dev)
{
	if (!dev || !dev->initialized) {
		return -EINVAL;
	}
	return write_u8(dev, VL53L4CD_SYSTEM_INTERRUPT_CLEAR, 0x01);
}

int vl53l4cd_start_continuous(struct vl53l4cd_dev *dev)
{
	uint32_t inter_meas;
	int err;

	if (!dev || !dev->initialized) {
		return -EINVAL;
	}

	/*
	 * Mirrors Pololu startContinuous(): pick the SYSTEM_START opcode based
	 * on whether INTERMEASUREMENT_MS is zero (continuous, 0x21) or non-zero
	 * (autonomous low power, 0x40).
	 */
	err = read_u32(dev, VL53L4CD_INTERMEASUREMENT_MS, &inter_meas);
	if (err != 0) {
		return err;
	}

	return write_u8(dev, VL53L4CD_SYSTEM_START, inter_meas == 0 ? 0x21 : 0x40);
}

int vl53l4cd_stop_continuous(struct vl53l4cd_dev *dev)
{
	if (!dev || !dev->initialized) {
		return -EINVAL;
	}
	return write_u8(dev, VL53L4CD_SYSTEM_START, 0x80);
}

int vl53l4cd_set_range_timing(struct vl53l4cd_dev *dev,
			      uint8_t budget_ms,
			      uint32_t inter_meas_ms)
{
	uint16_t osc_frequency = 0;
	uint16_t clock_pll_raw = 0;
	uint32_t timing_budget_us;
	uint32_t macro_period_us;
	uint32_t tmp;
	uint16_t ls_byte;
	uint8_t  ms_byte;
	int err;

	if (!dev || !dev->initialized) {
		return -EINVAL;
	}
	if (budget_ms < 10 || budget_ms > 200) {
		return -EINVAL;
	}
	if (inter_meas_ms != 0 && inter_meas_ms <= budget_ms) {
		return -EINVAL;
	}

	err = read_u16(dev, VL53L4CD_OSC_FREQUENCY, &osc_frequency);
	if (err != 0) {
		return err;
	}
	if (osc_frequency == 0) {
		return -ENODEV;
	}

	timing_budget_us = (uint32_t)budget_ms * 1000U;
	macro_period_us  = ((uint32_t)2304U * (0x40000000U / osc_frequency)) >> 6;

	if (inter_meas_ms == 0) {
		err = write_u32(dev, VL53L4CD_INTERMEASUREMENT_MS, 0);
		if (err != 0) {
			return err;
		}
		timing_budget_us -= 2500U;
	} else {
		uint32_t inter_measurement;

		err = read_u16(dev, VL53L4CD_RESULT_OSC_CALIBRATE_VAL, &clock_pll_raw);
		if (err != 0) {
			return err;
		}

		/*
		 * Pololu uses a float factor of 1.055; we use the fixed-point
		 * form (ms * pll * 1055 / 1000) to keep soft-float out of the
		 * image. clock_pll value is the low 10 bits of OSC_CALIBRATE.
		 */
		uint32_t clock_pll = (uint32_t)(clock_pll_raw & 0x3FFU);

		inter_measurement = (inter_meas_ms * clock_pll * 1055U) / 1000U;
		err = write_u32(dev, VL53L4CD_INTERMEASUREMENT_MS, inter_measurement);
		if (err != 0) {
			return err;
		}
		timing_budget_us -= 4300U;
		timing_budget_us /= 2U;
	}

	timing_budget_us <<= 12;

	tmp = (macro_period_us * 16U) >> 6;
	ls_byte = (uint16_t)(((timing_budget_us + (tmp >> 1)) / tmp) - 1U);
	ms_byte = 0;
	while (ls_byte > 0xFFU) {
		ls_byte >>= 1;
		ms_byte++;
	}
	err = write_u16(dev, VL53L4CD_RANGE_CONFIG_A,
			((uint16_t)ms_byte << 8) | ls_byte);
	if (err != 0) {
		return err;
	}

	tmp = (macro_period_us * 12U) >> 6;
	ls_byte = (uint16_t)(((timing_budget_us + (tmp >> 1)) / tmp) - 1U);
	ms_byte = 0;
	while (ls_byte > 0xFFU) {
		ls_byte >>= 1;
		ms_byte++;
	}
	err = write_u16(dev, VL53L4CD_RANGE_CONFIG_B,
			((uint16_t)ms_byte << 8) | ls_byte);
	if (err != 0) {
		return err;
	}

	return 0;
}

int vl53l4cd_read_range_mm(struct vl53l4cd_dev *dev, uint16_t *range_mm, uint8_t *status_out)
{
	uint8_t buf[15];
	uint8_t raw_status;
	int err;

	if (!dev || !dev->initialized || !range_mm || !status_out) {
		return -EINVAL;
	}

	/*
	 * Block-read 15 bytes from RESULT_RANGE_STATUS (0x0089) — same span as
	 * Pololu readResults(). We only consume bytes [0] (raw status, low 5
	 * bits) and [13..14] (distance, big-endian uint16 mm); SPAD count,
	 * signal/ambient rates, and sigma are ignored for this phase.
	 */
	err = reg_read(dev, VL53L4CD_RESULT_RANGE_STATUS, buf, sizeof(buf));
	if (err != 0) {
		return err;
	}

	raw_status = buf[0] & 0x1FU;
	*status_out = (raw_status < ARRAY_SIZE(vl53l4cd_status_rtn))
			? vl53l4cd_status_rtn[raw_status] : 255U;

	*range_mm = ((uint16_t)buf[13] << 8) | buf[14];
	return 0;
}

static int wait_data_ready(struct vl53l4cd_dev *dev, uint32_t timeout_ms)
{
	int64_t deadline = k_uptime_get() + (int64_t)timeout_ms;
	bool ready = false;
	int err;

	while (k_uptime_get() < deadline) {
		err = vl53l4cd_data_ready(dev, &ready);
		if (err == 0 && ready) {
			return 0;
		}
		k_sleep(K_MSEC(1));
	}
	return -ETIMEDOUT;
}

int vl53l4cd_init(struct vl53l4cd_dev *dev, const struct device *i2c, uint16_t addr)
{
	uint16_t model_id = 0;
	uint8_t  fw_status = 0;
	int64_t  deadline;
	int err;

	if (!dev || !i2c) {
		return -EINVAL;
	}

	dev->i2c = i2c;
	dev->addr = addr;
	dev->initialized = true; /* allow the low-level helpers to run */

	if (!device_is_ready(i2c)) {
		dev->initialized = false;
		return -ENODEV;
	}

	err = read_u16(dev, VL53L4CD_IDENTIFICATION_MODEL_ID, &model_id);
	if (err != 0) {
		LOG_ERR("model-id read failed (%d)", err);
		dev->initialized = false;
		return -ENODEV;
	}
	if (model_id != VL53L4CD_MODEL_ID) {
		LOG_ERR("unexpected model id 0x%04x (expected 0x%04x)",
			model_id, VL53L4CD_MODEL_ID);
		dev->initialized = false;
		return -ENODEV;
	}

	/* Wait for FW boot status to reach 0x03 (max ~1.2 ms per datasheet). */
	deadline = k_uptime_get() + (int64_t)VL53L4CD_BOOT_TIMEOUT_MS;
	while (k_uptime_get() < deadline) {
		err = read_u8(dev, VL53L4CD_FIRMWARE_SYSTEM_STATUS, &fw_status);
		if (err == 0 && fw_status == 0x03U) {
			break;
		}
		k_sleep(K_MSEC(1));
	}
	if (fw_status != 0x03U) {
		LOG_ERR("firmware boot status stuck at 0x%02x", fw_status);
		dev->initialized = false;
		return -ETIMEDOUT;
	}

	/*
	 * Pololu init(true, false): 2V8 IO, fast-mode (not fast-mode-plus).
	 * 0x2D bit-5/2 control fast-mode-plus (we leave 0); 0x2E/0x2F set the
	 * I2C / GPIO IO voltage domain to 2.8 V.
	 */
	err  = write_u8(dev, 0x002D, 0x00);
	err |= write_u8(dev, 0x002E, 0x01);
	err |= write_u8(dev, 0x002F, 0x01);
	if (err != 0) {
		dev->initialized = false;
		return -EIO;
	}

	/*
	 * Load the ULD default configuration table at 0x30..0x87. Chunked into
	 * 30-byte blocks to stay byte-identical to the Pololu source (which
	 * chunks due to the Arduino Wire 32-byte TX buffer); on nRF52840 we
	 * could send the whole block in one transaction, but chunking keeps
	 * the port easy to audit against the upstream library.
	 */
	const uint8_t block_size = 30;
	for (uint8_t start_reg = 0x30; start_reg <= 0x87; start_reg += block_size) {
		uint8_t end_reg = MIN((uint8_t)(start_reg + block_size - 1U), (uint8_t)0x87);
		uint8_t n = end_reg - start_reg + 1U;

		err = reg_write(dev, (uint16_t)start_reg,
				&vl53l4cd_default_config[start_reg - 0x30], n);
		if (err != 0) {
			LOG_ERR("default config write at 0x%02x failed (%d)", start_reg, err);
			dev->initialized = false;
			return -EIO;
		}
	}

	/* Start VHV: required one-time temperature calibration on first ranging. */
	err = write_u8(dev, VL53L4CD_SYSTEM_START, 0x40);
	if (err != 0) {
		dev->initialized = false;
		return -EIO;
	}

	err = wait_data_ready(dev, VL53L4CD_VHV_TIMEOUT_MS);
	if (err != 0) {
		LOG_ERR("VHV calibration timed out");
		dev->initialized = false;
		return err;
	}

	err  = vl53l4cd_clear_interrupt(dev);
	err |= vl53l4cd_stop_continuous(dev);
	err |= write_u8(dev,  VL53L4CD_VHV_CONFIG_TIMEOUT_MACROP_LOOP_BD, 0x09);
	err |= write_u8(dev,  0x000B, 0x00);
	err |= write_u16(dev, 0x0024, 0x0500);
	if (err != 0) {
		dev->initialized = false;
		return -EIO;
	}

	/* Default 50 ms timing budget in continuous mode (inter-meas = 0). */
	err = vl53l4cd_set_range_timing(dev, 50, 0);
	if (err != 0) {
		dev->initialized = false;
		return err;
	}

	LOG_INF("VL53L4CD ready (addr=0x%02x, 50 ms timing budget, continuous)", addr);
	return 0;
}
```

## src/vl53l4cd_zephyr.h
```c
#ifndef FLIGHTCAP_VL53L4CD_ZEPHYR_H
#define FLIGHTCAP_VL53L4CD_ZEPHYR_H

#include <stdbool.h>
#include <stdint.h>

#include <zephyr/device.h>

/**
 * Minimal Zephyr port of the relevant subset of Pololu's VL53L4CD Arduino
 * library (https://github.com/pololu/vl53l4cd-arduino), which itself is
 * derived from ST's Ultra Lite Driver (STSW-IMG026).
 *
 * - 16-bit register addresses are encoded MSB first per transaction.
 * - The default polarity is active-low INT (set by the 0x30 byte of the ULD
 *   default config). vl53l4cd_data_ready() assumes this; do not change the
 *   polarity unless you also update that helper.
 * - Caller owns the I2C bus device pointer and the 7-bit slave address.
 */
struct vl53l4cd_dev {
	const struct device *i2c;
	uint16_t addr; /* 7-bit I2C address (default 0x29) */
	bool initialized;
};

/**
 * Bring the sensor up: model-ID check, boot wait, ULD default config block,
 * VHV start, and a default 50 ms timing budget in continuous mode (0 ms
 * inter-measurement). Mirrors Pololu's init(true, false) — 2V8 IO, fast-mode
 * (not fast-mode-plus).
 *
 * @retval 0          Success.
 * @retval -ENODEV    I2C bus not ready, or model-ID mismatch (no sensor).
 * @retval -ETIMEDOUT FW_SYSTEM_STATUS did not reach 0x03 within ~100 ms.
 * @retval -EIO       Other I2C transaction failure.
 */
int vl53l4cd_init(struct vl53l4cd_dev *dev, const struct device *i2c, uint16_t addr);

/**
 * Set the timing budget (10..200 ms) and inter-measurement period
 * (0 = continuous, otherwise must be > budget).
 */
int vl53l4cd_set_range_timing(struct vl53l4cd_dev *dev,
			      uint8_t budget_ms,
			      uint32_t inter_meas_ms);

int vl53l4cd_start_continuous(struct vl53l4cd_dev *dev);
int vl53l4cd_stop_continuous(struct vl53l4cd_dev *dev);

/** Non-blocking data-ready poll over I2C. */
int vl53l4cd_data_ready(struct vl53l4cd_dev *dev, bool *ready);

/**
 * Block-read the 15-byte result frame at 0x0089 and return the range plus
 * the remapped status code (0 == valid measurement).
 */
int vl53l4cd_read_range_mm(struct vl53l4cd_dev *dev,
			   uint16_t *range_mm,
			   uint8_t *status);

int vl53l4cd_clear_interrupt(struct vl53l4cd_dev *dev);

#endif /* FLIGHTCAP_VL53L4CD_ZEPHYR_H */
```
