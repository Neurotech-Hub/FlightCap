## applications/juxta5-8-prod/sample.yaml
```yaml
sample:
  name: Juxta5-8 Production Hublink
  description: >
    Hublink-compatible BLE service with internal flash settings and
    external NOR append-only CSV logging.

common:
  tags:
    - juxta
    - bluetooth
    - flash
    - production

tests:
  applications.juxta5-8-prod:
    platform_allow:
      - Juxta5-8_nRF52840
    harness: console
```

## boards/NeurotechHub/FlightCap_nRF52833/FlightCap_nRF52833_defconfig
```kconfig
# Hardware protection
CONFIG_ARM_MPU=y
CONFIG_HW_STACK_PROTECTION=y

# External crystals: 32.768 kHz on P0.00/P0.01 (LF), 32 MHz HFXO on P0.16/P0.17.
# nRF52 clock source is Kconfig-only (no lfxo/hfxo DTS nodes in NCS 3.0).
CONFIG_CLOCK_CONTROL_NRF_K32SRC_XTAL=y
CONFIG_CLOCK_CONTROL_NRF_K32SRC_50PPM=y

# Essential peripherals
CONFIG_GPIO=y
CONFIG_GPIO_NRFX=y
CONFIG_I2C=y
CONFIG_I2C_NRFX=y
CONFIG_SPI=y
CONFIG_SPI_NRFX=y
CONFIG_ADC=y
CONFIG_ADC_NRFX_SAADC=y

# Console on RTT
CONFIG_USE_SEGGER_RTT=y
CONFIG_RTT_CONSOLE=y
CONFIG_CONSOLE=y

# No UART console on this board
CONFIG_UART_NRFX=n
CONFIG_UART_CONSOLE=n

# Note: BT controller TX power (CONFIG_BT_CTLR_TX_PWR_ANTENNA=8) is set per
# application in each BT-using app's prj.conf rather than here.
```

## boards/NeurotechHub/FlightCap_nRF52833/board.yml
```yaml
board:
  name: FlightCap_nRF52833
  vendor: NeurotechHub
  socs:
    - name: nrf52833
```

## boards/NeurotechHub/FlightCap_nRF52840/FlightCap_nRF52840_defconfig
```kconfig
# Hardware protection
CONFIG_ARM_MPU=y
CONFIG_HW_STACK_PROTECTION=y

# Essential peripherals
CONFIG_GPIO=y
CONFIG_GPIO_NRFX=y
CONFIG_SPI=y
CONFIG_SPI_NRFX=y
CONFIG_I2C=y
CONFIG_I2C_NRFX=y
CONFIG_ADC=y
CONFIG_ADC_NRFX_SAADC=y
CONFIG_SENSOR=y

# Console on RTT
CONFIG_USE_SEGGER_RTT=y
CONFIG_RTT_CONSOLE=y
CONFIG_CONSOLE=y

# No UART console on this board
CONFIG_UART_NRFX=n
CONFIG_UART_CONSOLE=n

# Note: BT controller TX power (CONFIG_BT_CTLR_TX_PWR_ANTENNA=8) is set per
# application in each BT-using app's prj.conf rather than here. Setting it at
# the board level applies it to every sysbuild child image -- including
# MCUboot, which does not build the BT controller and therefore warns about
# the unsatisfied dependency. See applications/flightcap-{prod,ble-test}/prj.conf.
```

## boards/NeurotechHub/FlightCap_nRF52840/board.yml
```yaml
board:
  name: FlightCap_nRF52840
  vendor: NeurotechHub
  socs:
    - name: nrf52840
```
